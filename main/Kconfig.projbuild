## main/Kconfig.projbuild
```kconfig
menu "Game Boy"
    config GB_EPD_T7
        bool "Panel profile GDEY075T7 instead of GEN2 (tiny-paper's default on the TRMNL OG is GEN2)"
        default n
    config GB_FULL_EVERY
        int "Full refresh after this many partial refreshes"
        default 300
        range 1 1000
    config GB_START_HOLD_MS
        int "Hold the button this long for Start"
        default 1000
    config GB_NO_PANEL
        bool "No panel attached (QEMU, tools/qemu.sh): skip the panel driver, a refresh takes 1 s"
        default n
    config GB_PAD_BLE
        bool "Bluetooth LE gamepad (Xbox Wireless Controller)"
        default y
    config GB_STATE_EVERY_S
        int "Save state (full snapshot, resumed at boot) every this many seconds of running, 0 = off"
        default 120
        range 0 86400
endmenu
```
